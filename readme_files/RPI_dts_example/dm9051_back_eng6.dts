/dts-v1/;

/ {
	compatible = "brcm,bcm2708";

	fragment@0 {
		target = <0xffffffff>;

		__overlay__ {
			#address-cells = <0x1>;
			#size-cells = <0x0>;
			status = "okay";

			dm9051@0 {
				compatible = "davicom,dm9051";
				reg = <0x1>;
				pinctrl-names = "default";
				pinctrl-0 = <0x1>;
				interrupt-parent = <0xffffffff>;
				interrupts = <0x1a 0x4>;
				spi-max-frequency = <0x1dc1300>;
				status = "okay";
				linux,phandle = <0x2>;
				phandle = <0x2>;
			};
		};
	};

	fragment@1 {
		target = <0xffffffff>;

		__overlay__ {

			eth1_pins {
				brcm,pins = <0x1a>;
				brcm,function = <0x0>;
				brcm,pull = <0x0>;
				linux,phandle = <0x1>;
				phandle = <0x1>;
			};
		};
	};

	__overrides__ {
		int_pin = [00 00 00 02 69 6e 74 65 72 72 75 70 74 73 3a 30 00 00 00 00 01 62 72 63 6d 2c 70 69 6e 73 3a 30 00];
		speed = <0x2 0x7370692d 0x6d61782d 0x66726571 0x75656e63 0x793a3000>;
	};

	__symbols__ {
		eth1 = "/fragment@0/__overlay__/dm9051@0";
		eth1_pins = "/fragment@1/__overlay__/eth1_pins";
	};

	__fixups__ {
		spi0 = "/fragment@0:target:0";
		gpio = "/fragment@0/__overlay__/dm9051@0:interrupt-parent:0", "/fragment@1:target:0";
	};

	__local_fixups__ {

		fragment@0 {

			__overlay__ {

				dm9051@0 {
					pinctrl-0 = <0x0>;
				};
			};
		};

		__overrides__ {
			int_pin = <0x0 0x11>;
			speed = <0x0>;
		};
	};
};
